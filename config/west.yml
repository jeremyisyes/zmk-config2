## config/west.yml
```yaml
manifest:
  remotes:
    - name: zmkfirmware
      url-base: https://github.com/zmkfirmware
    - name: tominabox1
      url-base: https://github.com/tominabox1/
    - name: nicell
      url-base: https://github.com/Nicell/
    - name: okke
      url-base: https://github.com/okke-formsma
    - name: pete
      url-base: https://github.com/petejohanson/
  projects:
    - name: zmk
      remote: zmkfirmware
      revision: 28ef19488d3943fbf404189cee3ecfec9baa70da # last commit using Zephyr 2.5
      import: app/west.yml
  self:
    path: config
```
